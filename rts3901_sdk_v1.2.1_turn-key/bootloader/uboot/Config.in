## rts3901_sdk_v1.2.1_turn-key/bootloader/uboot/Config.in
```kconfig
#
# For a description of the syntax of this configuration file,
# see scripts/kbuild/config-language.txt.
#

mainmenu "Bootloader Configuration"

#menu "Chip Selection"

choice
	prompt "Chip Selection"
	default BOARD_RTS3901
	help 
	  select chip type

#config BOARD_RLE0745
#	bool "RLE0745"
#	help
#	  Enable option for RLE0745

config BOARD_RTS3901
	bool "RTS3901"
	help
	  Enable option for RTS3901

#config BOARD_RTS3903
#	bool "RTS3903"
#	help
#	  Enable option for RTS3903

endchoice

#endmenu

#menu "Hardware Type"

choice
	prompt "Hardware Type"
	default TARGET_ASIC
	help
	  select IC or FPGA

config TARGET_ASIC
	bool "ASIC"
	help
	  Enable options for Asic.

#config TARGET_FPGA
#	bool "FPGA"
#	help
#	  Enable options for FPGA.

endchoice

#endmenu

choice
	prompt "flash partition definition"
	default PARTITION_IN_BSP
	help
	  flash partition definition selection

config PARTITION_IN_BSP
	bool "refer to bsp directory"
	help
	  partition.ini file defined in bsp directory

config PARTITION_IN_UBOOT
	bool "refer to local directory"
	help 
	  partition.ini file defined in uboot directory

endchoice
#menu 'DDR selection'

choice
	prompt "DDR type"
	default DDR3_2GBIT_DEMOBOARD_GENERAL
	help
	  DDR type selection

#config DDR_H5TQ2G
#	bool "DDR3 H5TQ2G(Hynix 256MB)"
#	depends on TARGET_FPGA || BOARD_RTS3901
#	help
#	  Enable option for DDR H5TQ2G
#
config DDR_W975116KG
	bool "DDR2 MCM(Winbond 64MB)"
	depends on TARGET_ASIC
	help
	  Enable option for DDR W975116KG
#
#config DDR_W631GG6KB
#	bool "DDR3 W631GG6KB(Winbond 128MB)"
#	depends on TARGET_ASIC && BOARD_RTS3901
#	help
#	  Enable option for DDR W31GG6KB
#
#config DDR_W632GG6KB
#	bool "DDR3 W632GG6KB(Winbond 256MB)"
#	depends on TARGET_ASIC && BOARD_RTS3901
#	help
#	  Enable option for DDR W632GG6KB
#
#config DDR_NT5CC64M16IP
#	bool "DDR3 NT5CC64M16IP(Nanya 128MB)"
#	depends on TARGET_ASIC && BOARD_RTS3901
#	help
#	  Enable option for DDR NT5CC64M16IP
#
#config DDR_NT5CC128M16IP
#	bool "DDR3 NT5CC128M16IP(Nanya 256MB)"
#	depends on TARGET_ASIC && BOARD_RTS3901
#	help
#	  Enable option for DDR NT5CC128M16IP
#
#config DDR_M15F1G1664A
#	bool "DDR3 M15F1G1664A(ESMT 128MB)"
#	depends on TARGET_ASIC && BOARD_RTS3901
#	help
#	  Enable option for DDR M15F1G1664A
#
#
#config DDR_M15F2G16128A
#	bool "DDR3 M15F2G16128A(ESMT 256MB)"
#	depends on TARGET_ASIC && BOARD_RTS3901
#	help
#	  Enable option for DDR M15F2G16128A
#
config DDR3_ESMT_1GBIT
	bool "DDR3 MCM(ESMT 128MB)"
	depends on TARGET_ASIC
	help
	  Ebable option for MCM 1Gbit DDR3

config DDR3_2GBIT_DEMOBOARD_GENERAL
	bool "2Gbit DDR3 DemoBOARD general"
	depends on TARGET_ASIC
	help
	  Enable option for 2Gbit DDR on demo board

config DDR3_1GBIT_DEMOBOARD_GENERAL
	bool "1Gbit DDR3 DemoBOARD general"
	depends on TARGET_ASIC
	help
	  Enable option for 1Gbit DDR on demo board

config DDR3_2GBIT_QABOARD_V11
	bool "2Gbit DDR3 QABoard V1.1"
	depends on TARGET_ASIC
	help
	  Enable option for 2Gbit DDR on QA Board V1.1

config CONFIG_DDR_H5TQ2G
	bool "DDR3 H5TQ2G(Hynix 256MB)"
	depends on TARGET_FPGA
	help
	  Enable option for DDR H5TQ2G

endchoice

choice
	prompt "DDR speed"
	default DDR_1066
	depends on TARGET_ASIC
	help
	  select ddr clock

config DDR_800
	bool "800"
	depends on DDR_W975116KG
	help
	  select ddr dqs clock to 800/2.

config DDR_1066
	bool "1066"
	help
	  select ddr dqs clock to 1066/2.

config DDR_1333
	bool "1333"
	depends on DDR3_1GBIT_DEMOBOARD_GENERAL || DDR3_2GBIT_DEMOBOARD_GENERAL 
	help
	  select ddr dqs clock to 1333/2

#config DDR_1600
#	bool "1600"
#	help
#	  select ddr dqs clock to 1600/2

endchoice

choice
	prompt "DDR ODT on/off"
	default ODT_ON
	depends on TARGET_ASIC
	help
	  select ddr odt on or off

config ODT_ON
	bool "ODT ON"
	help
	  set ddr odt on

config ODT_OFF
	bool "ODT OFF"
	depends on DDR_800 || DDR_1066
	help
	  set ddr odt off
endchoice

choice
	prompt "cpu clock setting"
	default CPU_500M
	depends on TARGET_ASIC
	help
	  set cpu clock frequency

#config CPU_600M
#	bool "600MHz"
#	help
#	  set cpu clock to 600MHz

config CPU_500M
	bool "500MHz"
	help
	  set cpu clock to 500MHz

config CPU_400M
	bool "400MHz"
	help
	  set cpu clock to 400MHz

config CPU_333M
	bool "333MHz"
	help
	  set cpu clock to 333MHz

config CPU_300M
	bool "300MHz"
	help
	  set cpu clock to 300MHz

config CPU_250M
	bool "250MHz"
	help
	  set cpu clock to 250MHz

config CPU_240M
	bool "240MHz"
	help
	  set cpu clock to 300MHz

config CPU_200M
	bool "200MHz"
	help
	  set cpu clock to 200MHz


endchoice
#endmenu
```

## rts3901_sdk_v1.2.1_turn-key/linux-3.10/arch/rlx/Kconfig.rlx
```kconfig
#
# Realtek Semiconductor Corp.
#
# RLX Linux Kernel Configuration
#
# Tony Wu (tonywu@realtek.com)
# Dec. 07, 2008
#

source "../target/selection/config.top"
source "../target/selection/config.soc"

#
# SoC configuration
#
menu "SoC configuration"

choice
	prompt "Timer Source"

config ARCH_CEVT_RLX
	bool "RLX internal counter"

config ARCH_CEVT_EXT
	bool "DWAPB external timer"

endchoice

config SOC_ENABLE_PCI
	bool "Enable PCI controller"
	default n

config SOC_ENABLE_USB
	bool "Enable USB controller"
	default n

config SOC_RESV_CONTIG_MEM
	bool "Reserve contiguous memory"
	default n

config SOC_RESVD_MEM_SIZE
	int "Reserved memory size (MB)"
	range 0 100
	default 64
	depends on SOC_RESV_CONTIG_MEM

config SOC_FPGA_CODE
	bool "Enable FPGA code"
	default n
	help
	  This option enable code for FPGA only. For ASIC this option
	  should be turned off.

config SOC_QC_CODE
	bool "Enable QC code"
	default n
	help
	  This option enable code for Quality Control procedure, such as
	  MP or FT.

comment "Build RootFS Options"

choice
	prompt "File system to mount root"
	help
	  This option is mainly to assist to decide how to build rootfs,
	  because echo kind of file system for rootfs will uses different
	  flow in our design.

config ROOTFS_RAMFS
	bool "Linux Built-in RAMFS"
	depends on INITRAMFS_SOURCE != ""

config ROOTFS_SQUASH
	bool "SquashFS"
	depends on SQUASHFS

endchoice

endmenu

#
# RLX
#
config RLX
	bool
	default y
	select BOOT_ELF32
	select SYS_SUPPORTS_ARBIT_HZ
	select SYS_HAS_EARLY_PRINTK

config MACH_RLX
	bool
	default y
	select CPU_SUPPORTS_HIGHMEM
	select CPU_SUPPORTS_32BIT_KERNEL
	select SYS_SUPPORTS_32BIT_KERNEL
	select SYS_SUPPORTS_LITTLE_ENDIAN if ARCH_CPU_EL
	select SYS_SUPPORTS_BIG_ENDIAN if ARCH_CPU_EB
	select SYS_SUPPORTS_SMP if ARCH_CPU_SMP
	select SYS_SUPPORTS_CMP if ARCH_CPU_SMP
	select IRQ_CPU if ARCH_IRQ_CPU
	select IRQ_VEC if ARCH_IRQ_VEC
	select IRQ_GIC if ARCH_IRQ_GIC
	select HW_HAS_PCI if (ARCH_BUS_PCI && SOC_ENABLE_PCI)
	select HW_HAS_USB if (ARCH_BUS_USB && SOC_ENABLE_USB)
	select ARCH_SUPPORTS_MSI if (ARCH_BUS_PCI_MSI && SOC_ENABLE_PCI)
	select CPU_HAS_FPU if CPU_ENABLE_FPU
	select CPU_HAS_LLSC if ARCH_CPU_LLSC
	select CPU_HAS_RADIAX if CPU_ENABLE_RADIAX
	select CPU_HAS_SLEEP if ARCH_CPU_SLEEP
	select CPU_HAS_SYNC if ARCH_CPU_SYNC
	select CPU_HAS_TLS if CPU_ENABLE_TLS
	select CPU_HAS_ULS if ARCH_CPU_ULS
	select CPU_HAS_WMPU if CPU_ENABLE_WMPU
	select DMA_COHERENT if ARCH_CACHE_CAP
	select DMA_NONCOHERENT if !ARCH_CACHE_CAP
	select SYS_SUPPORTS_ZBOOT
	select HAVE_CLK
	select COMMON_CLK
	select CLKDEV_LOOKUP
	select PINCTRL
	select IRQ_DOMAIN

#
# CPU
#
config CPU_RLX4181
	bool
	default y if ARCH_CPU_RLX4181

config CPU_RLX5181
	bool
	default y if ARCH_CPU_RLX5181
	select CPU_HAS_CLS

config CPU_RLX5280
	bool
	default y if ARCH_CPU_RLX5280
	select CPU_HAS_CLS

config CPU_RLX4281
	bool
	select CPU_HAS_BUS_ERROR
	default y if ARCH_CPU_RLX4281 || ARCH_CPU_RLX4381
	default y if ARCH_CPU_RLX4271 || ARCH_CPU_RLX4371

config CPU_RLX5281
	bool
	select CPU_HAS_BUS_ERROR
	default y if ARCH_CPU_RLX5281 || ARCH_CPU_RLX5381
	default y if ARCH_CPU_RLX5271 || ARCH_CPU_RLX5371
	select CPU_HAS_CLS

config CPU_HAS_RADIAX
	bool

config CPU_HAS_SLEEP
	bool

config CPU_HAS_CLS
	bool

config CPU_HAS_FPU
	bool

config CPU_HAS_LLSC
	bool

config CPU_HAS_ULS
	bool

config CPU_HAS_TLS
	bool

config CPU_HAS_LLSC
	bool

config CPU_HAS_BUS_ERROR
	bool

config CPU_HAS_WMPU
	bool
	select HARDWARE_WATCHPOINTS

#
# IRQ
#
config IRQ_VEC
	bool

#
# Timer
#
config CEVT_EXT
	bool
	default y if ARCH_CEVT_EXT
	default y if !CPU_RLX4281 && !CPU_RLX5281

config CEVT_RLX
	bool
	default y if ARCH_CEVT_RLX
	default n if !CPU_RLX4281 && !CPU_RLX5281

config CSRC_RLX
	bool
	default y if ARCH_CEVT_RLX
	default n if !CPU_RLX4281 && !CPU_RLX5281

#
# CACHE
#
config CPU_HAS_WBC
	bool
	default y if ARCH_CACHE_WBC

config CPU_HAS_L2C
	bool
	default y if ARCH_CACHE_L2C

config CPU_HAS_WBIC
	bool
	default y if ARCH_CACHE_WBIC

#
# BUS
#
config HW_HAS_USB
	bool

#
# MISC
#
config USE_UAPI
	bool
	default y
	help
	  Starting Linux 3.7, UAPI is enabled.
```

## rts3901_sdk_v1.2.1_turn-key/linux-3.10/drivers/misc/rts_ipcam/Kconfig
```kconfig
#
# rts_ipcam misc device configuration
#

menu "Realtek IPCam misc devices"

config DBG_IOMEM
	tristate "IOMEM Driver for debug"
	help
	  If this driver is compiled as a module, it will be named dbg_iomem.

config DBG_IOMEM_DMATEST
	bool "IOMEM DMA Test"
	depends on DBG_IOMEM
	help
	  Use IOMEM to test DMA

config RTS_EFUSE
	tristate "EFUSE Driver"
	help
	  If this driver is compiled as a module, it will be named rts_efuse.

config RTS_EFUSE_SYSFS
	bool "EFUSE SYSFS utility"
	default n
	depends on RTS_EFUSE
	help
	  This enables SYSFS support for the efuse driver and exports
	  efuse read/write interface to user space. This is mostly useful
	  to diagnose efuse problems and program efuse by shell.

config WLAN_WPS
	tristate "Wifi wps_gpio driver"
	default n
	help
	  Enable GPIO for wifi wps_pbc

if WLAN_WPS
	config WPS_GPIO_NUM
		int "WPS_GPIO_NUM(1-16)"
		range 1 16
		default "1"
endif

endmenu
```

## rts3901_sdk_v1.2.1_turn-key/linux-3.10/drivers/net/ethernet/realtek/rtl8168g/Kconfig
```kconfig
#
# Realtek device configuration
#

config RTL8168G
	bool "Realtek RTL-8168G 10/100 Mbps Ethernet Adapter support"
	select CRC32
	select NET_CORE
	select MII
	select RTS_EFUSE
	---help---
	  Support for rtl8168g chipset.

if RTL8168G
config RTL8168_DMA_TEST
	bool "Enable rtl8168 RX driect connect TX for DMA test"

endif
```

## rts3901_sdk_v1.2.1_turn-key/linux-3.10/drivers/usb/dwc_otg_310b/Kconfig
```kconfig
menu "DesignWare USB_OTG support"
config DWC_OTG
	tristate "DWC_OTG support"
#	depends on SOC_RT305X
	---help---
	  This driver supports Ralink DWC_OTG

choice
	prompt "USB Operation Mode"
	depends on DWC_OTG
	default DWC_OTG_HOST_ONLY

config DWC_OTG_HOST_ONLY
	bool "HOST ONLY MODE"
	depends on DWC_OTG

config DWC_OTG_DEVICE_ONLY
	bool "DEVICE ONLY MODE"
	depends on DWC_OTG
	select USB_GADGET_DUALSPEED	

endchoice

# Selected by UDC drivers that support high-speed operation.
config USB_GADGET_DUALSPEED
	bool

# Selected by UDC drivers that support super-speed opperation
config USB_GADGET_SUPERSPEED
	bool
	depends on USB_GADGET_DUALSPEED
	
config DWC_OTG_DEBUG
	bool "Enable debug mode"
	depends on DWC_OTG

config DWC_OTG_DEBUG_VERBOSE
	bool "Enable debug verbose mode"
	depends on DWC_OTG

endmenu
```

## rts3901_sdk_v1.2.1_turn-key/users/Kconfig
```kconfig
#
# Realtek Semiconductor Corp.
#
# Tony Wu (tonywu@realtek.com)
# Dec. 7, 2008
#

source "system/Kconfig"
source "libs/Kconfig"
source "network/Kconfig"
source "devel/Kconfig"
source "utils/Kconfig"
source "benchmark/Kconfig"
source "rtscore/Kconfig"
source "ipcam/Kconfig"
source "drivers/Kconfig"
```

## rts3901_sdk_v1.2.1_turn-key/users/benchmark/Kconfig
```kconfig
menu "Benchmarks"

config PACKAGE_iperf
	tristate "iperf"
	default n
	help

config PACKAGE_iozone
	tristate "iozone"
	default n
	help
	  Enable iozone test suite

config PACKAGE_fio
	tristate "fio"
	default n
	select PACKAGE_libaio
	select PACKAGE_zlib
	help
	  Enable flexible I/O tester synthetic benchmark

endmenu
```

## rts3901_sdk_v1.2.1_turn-key/users/devel/Kconfig
```kconfig
#
# Realtek Semiconductor Corp.
#
# Tony Wu (tonywu@realtek.com)
# Dec. 7, 2008
#

menu "Darkside Applications"

config PACKAGE_gdbserver
	tristate "gdbserver"
	default n
	select PACKAGE_zlib
	help
	  gdbserver

config PACKAGE_python
	tristate "python"
	default n
	select PACKAGE_zlib
	help
	  python

config PACKAGE_ltrace
	tristate "ltrace"
	default n
	select PACKAGE_elfutils
	select PACKAGE_libiconv
	help
	  ltrace

config PACKAGE_oprofile
	tristate "oprofile"
	default n
	select PACKAGE_binutils
	select PACKAGE_libpopt
	select PACKAGE_zlib
	help
	  oprofile 0.9.8

config PACKAGE_strace
	tristate "strace"
	default n
	help
	  strace 4.7

config PACKAGE_systemtap
	tristate "systemtap"
	default n
	select PACKAGE_elfutils
	help
	  systemtap

endmenu
```

## rts3901_sdk_v1.2.1_turn-key/users/drivers/Kconfig
```kconfig
menu "Module Drivers"

source "drivers/audio/Kconfig"
source "drivers/sdhc/Kconfig"
source "drivers/video/Kconfig"
source "drivers/wifi/Kconfig"

endmenu
```

## rts3901_sdk_v1.2.1_turn-key/users/drivers/audio/Kconfig
```kconfig
menu "audio driver"

menuconfig PACKAGE_modules_audio
	tristate "RLX Sound Driver"
	help
	  RLX sound driver includes machine driver, platform driver and codec
	  driver. You can choose intern codec, extern codec or both by the
	  following configuration.

if PACKAGE_modules_audio

menuconfig SND_SOC_RLX_INTERN_CODEC
	bool "Intern Codec Supported"
	default y
	help
	  Support intern codec.

if SND_SOC_RLX_INTERN_CODEC

choice
	prompt "Selected Analog Input SRC"

config SND_SOC_RLX_INTERN_CODEC_AMIC
	bool "Amic"
	help
	  Analog Input SRC -- Amic.

config SND_SOC_RLX_INTERN_CODEC_LINEIN
	bool "Line-in"
	help
	  Analog Input SRC -- Line-in.

endchoice

if SND_SOC_RLX_INTERN_CODEC_AMIC

choice
	prompt "Selected AMIC POWER"

config SND_SOC_RLX_AMIC_IN_LDO
	bool "Intern LDO"
	help
	  AMIC INTERN POWER.

config SND_SOC_RLX_AMIC_PMU_RTP
	bool "PMU RTP"
	help
	  PMU LDO POWER.

endchoice

if SND_SOC_RLX_AMIC_PMU_RTP

choice
	prompt "Selected PMU REGULATOR"

config SND_SOC_RLX_AMIC_PMU_RTP_LDO1
	bool "LDO1"
	help
	  RTP LDO1.

endchoice

endif

endif

endif

#TODO: external card codec driver is needed to move
#      as kernel modules to support external card config
#menuconfig SND_SOC_RLX_EXTERN_CODEC
#	bool "Extern Codec Supported"
#	default n
#	help
#	  Support extern codec. You can choose the type of extern codec.
#
#if SND_SOC_RLX_EXTERN_CODEC
#
#choice
#	prompt "Selected Extern Codec"
#
#config SND_SOC_RLX_RT5651
#	bool "RT5651"
#	select SND_SOC_RT5651
#	help
#	  Support extern codec -- rt5651.
#
#endchoice
#
#endif

config SND_SOC_RLX_DEBUG
	bool "RLX Sound Debug"
	help
	  Show rlx sound debug message.

endif

endmenu
```

## rts3901_sdk_v1.2.1_turn-key/users/drivers/sdhc/Kconfig
```kconfig
menu "sdhc driver"

config PACKAGE_modules_mmc
	tristate "Realtek IPCAM SD/MMC Host Controller support"
	help
	 Support Realtek Ipcam SD/MMC card interface.

endmenu
```

## rts3901_sdk_v1.2.1_turn-key/users/drivers/video/Kconfig
```kconfig
menu "video driver"

config PACKAGE_modules_video
	tristate "Realtek Camera Support"
	help
	  Rts Soc Camera subsystem.

if PACKAGE_modules_video

config VIDEO_RTS_SOC
	tristate "Realtek soc camera device driver"
	---help---
	  This is a camera driver for Realtek Soc Camera

choice
	prompt "Select mcu fw in ddr or flash"
	depends on VIDEO_RTS_SOC
	---help---
	  This option defines the location where the MCU fw code locate

config RTS_MCU_FW_IN_DDR
	bool "DDR"

config RTS_MCU_FW_CUSTOM
	bool "CUSTOM"

endchoice

config VIDEO_HX280_ENC
	tristate "Realtek H264 encoder device driver base on Hantro's HX280"
	---help---
	  This is a H264 Encode device driver base on Hantro's HX280

config RTS_MJPEG_ENC
	tristate "Realtek mjpeg encoder device driver"
	---help---
	  This is a Realtek Mjpeg Encoder device driver

config RTS_RTSTREAM_INFO
	tristate "Realtek rtstream info driver"
	---help---
	  This driver help rtstream

endif

endmenu
```
