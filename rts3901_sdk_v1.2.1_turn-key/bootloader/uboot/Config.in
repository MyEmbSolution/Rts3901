## rts3901_sdk_v1.2.1_turn-key/users/drivers/wifi/Kconfig
```kconfig
menu "wifi driver"

config PACKAGE_rtl8188cus
	tristate "Realtek RTL8188C USB WiFi"
	default n
	help
	  realtek rtl8188c usb wifi card driver

config PACKAGE_rtl8188eus
	tristate "Realtek RTL8188E USB WiFi"
	default n
	help
	  realtek rtl8188e usb wifi card driver

config PACKAGE_rtl8188fu
	tristate "Realtek RTL8188F USB WiFi"
	default n
	help
	  realtek rtl8188f usb wifi card driver

config PACKAGE_rtl8189es
	tristate "Realtek RTL8189E SDIO WiFi"
	default n
	help
	  realtek rtl8189e sdio wifi card driver

config PACKAGE_rtl8192eus
	tristate "Realtek RTL8192E USB WiFi"
	default n
	help
	  realtek rtl8192e usb wifi card driver

config PACKAGE_rtl8192es
	tristate "Realtek RTL8192E SDIO WiFi"
	default n
	help
	  realtek rtl8192e sdio wifi card driver

config PACKAGE_rtl8812au
	tristate "Realtek RTL8812A USB WiFi"
	default n
	help
	  realtek rtl8812a usb wifi card driver

config PACKAGE_rtl8821au
	tristate "Realtek RTL8821A USB WiFi"
	default n
	help
	  realtek rtl8821a usb wifi card driver

config PACKAGE_rtl8821as
	tristate "Realtek RTL8821A SDIO WiFi"
	default n
	help
	  realtek rtl8821a sdio wifi card driver

config RTW_SUPER_LINK
	bool "Enable Realtek WiFi Super Link"
	depends on PACKAGE_rtl8188cus || PACKAGE_rtl8188eus || PACKAGE_rtl8192eus
	default n

config RTW_CONCURRENT_MODE
	bool "Enable Realtek WiFi Concurrent Mode"
	depends on PACKAGE_rtl8188eus || PACKAGE_rtl8188fu || PACKAGE_rtl8189es || \
		PACKAGE_rtl8192es || PACKAGE_rtl8192eus || PACKAGE_rtl8821as || \
		PACKAGE_rtl8821au || PACKAGE_rtl8812au
	default n
	help
	  realtek WiFi softap coexists with station mode
endmenu
```

## rts3901_sdk_v1.2.1_turn-key/users/ipcam/Kconfig
```kconfig
#
# Realtek Semiconductor Corp.
#
# Wei WANG (wei_wang@realsil.com.cn)
# Aug. 4, 2014
#

menu "IPCam packages"

config PACKAGE_ffmpeg
	tristate "ffmpeg"
	default n
	select PACKAGE_3rdparty
	select PACKAGE_3rdparty_libaacenc
	select PACKAGE_3rdparty_librtsmp3
	select PACKAGE_alsalib
	select PACKAGE_librtsisp
	select PACKAGE_opencore_amr
	help
	  ffmpeg

config PACKAGE_peacock
	tristate "peacock"
	select PACKAGE_ffmpeg
	select PACKAGE_libauth
	select PACKAGE_librtsisp
	select PACKAGE_3rdparty_librtsaec
	select PACKAGE_rtstream
	default n
	help
	  peacock, for streaming server

config PACKAGE_doorkeeper
        tristate "doorkeeper"
        default n
	help
	  doorkeeper, do action after got event(MD,Audio detection)


config PACKAGE_parrot
	tristate "parrot"
	default n
	select PACKAGE_ffmpeg
	select PACKAGE_peacock
	select PACKAGE_octopus
	select PACKAGE_3rdparty
	select PACKAGE_3rdparty_tutk
	select PACKAGE_aplayer
	select PACKAGE_rtstream
	select PACKAGE_hconf
	help
	  P2P streaming server

config PACKAGE_parrot_unit_test
	tristate "parrot unit test"
	default n
	depends on PACKAGE_parrot
	select PACKAGE_ffmpeg
	select PACKAGE_peacock
	select PACKAGE_octopus
	select PACKAGE_3rdparty
	select PACKAGE_3rdparty_tutk
	select PACKAGE_aplayer
	select PACKAGE_hconf
	select PACKAGE_rtstream
	help
	  parrot unit test

config PACKAGE_aplayer
	tristate "aplayer"
	select PACKAGE_ffmpeg
	select PACKAGE_rtstream
	default n

config PACKAGE_octopus
	tristate "octopus"
	default n
	help
          octopus, manager of camera, network and IO

config PACKAGE_octopus_plugin
	tristate "octopus plugin"
	depends on PACKAGE_octopus
	default n

if PACKAGE_octopus_plugin
	source ipcam/octopus_plugin/Kconfig
endif

config PACKAGE_webpages
	tristate "webpages"
	select PACKAGE_octopus
	select PACKAGE_octopus_plugin
	select OCTOPUS_PLUGIN_CAM
	select OCTOPUS_PLUGIN_IO
	select PACKAGE_neuralyzer
	select PACKAGE_librtsio
	select PACKAGE_librtsnm
	default n
	help
	  webpages

config PACKAGE_onvif
	tristate "onvif"
	select PACKAGE_octopus
	default n
	help
	  open network video interface forum

config PACKAGE_gaia
	tristate "gaia"
	select PACKAGE_octopus
	select PACKAGE_octopus_plugin
	select OCTOPUS_PLUGIN_CAM
	select PACKAGE_rtstream
	default n
	help
	  init camera settings

config PACKAGE_uvcd
	tristate "uvcd"
	select PACKAGE_h1_encoder
	select PACKAGE_OCTOPUS_PLUGIN_CAM
	default n
	help
	  support uvc preview

choice
        prompt "uvc version"
        depends on PACKAGE_uvcd
config UVC_10
        bool "UVC1.0"
config UVC_15
        bool "UVC1.5 H264"
endchoice

config MJPEG_V4L2_FILE_NUM
	depends on PACKAGE_uvcd
	int "MJPEG_V4L2_FILE_NUM(51-55)"
        range 51 55
        default "55"

comment "libraries"
config PACKAGE_libsysconf
	tristate "sysconf"
	default n
	select PACKAGE_jsonc
	select PACKAGE_cunit
	help
	 library for conf file

config PACKAGE_libsysconf_unit_test
	tristate "sysconf_unit_test"
	default n
	depends on PACKAGE_libsysconf
	select PACKAGE_cunit
	select PACKAGE_jsonc
	help

config PACKAGE_libauth
	tristate "libauth"
	default n
	help

comment "utils"
config PACKAGE_neuralyzer
        tristate "neuralyzer"
        default n
	help
	  Image update tool

config PACKAGE_isptuning
	tristate "isptuning"
	select PACKAGE_librtsisp
	default n
	help
	  ISP tuning tool

if PACKAGE_isptuning
	source ipcam/isp_tuning/Kconfig
endif

config PACKAGE_hconf
	tristate "hconf"
	default n

config PACKAGE_ft2_test
	tristate "ft2 test"
	default n
	help
	  soc ipcam ft2 test

config PACKAGE_linuxtest
	tristate "linux test"
	default n
	help
	  linux test case

if PACKAGE_linuxtest
source ipcam/linux_test/Kconfig
endif

config PACKAGE_dbgutils
	tristate "dbgutils"
	default n
	help
	  Utils for debug

if PACKAGE_dbgutils
source ipcam/dbgutils/Kconfig
endif

comment "system"
config PACKAGE_scripts
	bool "system scripts"
	default n
	help
	  system scripts.

if PACKAGE_scripts

config PACKAGE_scripts_automount
	bool "mdev automount"
	default n
	help
	  mdev automount scripts.

config PACKAGE_scripts_udhcpc
	bool "udhcpc script"
	default n
	help
	  udhcpc default scripts

endif

config PACKAGE_preamble
	tristate "preamble"
	select PACKAGE_libsysconf
	default y
	help
	  preamble config

comment "network"
config PACKAGE_super_link
	tristate "super_link"
	default n

config PACKAGE_networkmanager
	tristate "networkmanager"
	select PACKAGE_libsysconf
	select PACKAGE_hconf
	default n

config PACKAGE_camfinder
	tristate "camfinder"
	select PACKAGE_libsysconf
	select PACKAGE_libauth
	default n

if PACKAGE_camfinder
choice
  prompt "Select target camfinder"

config PACKAGE_realsil
  bool "realsil"

config PACKAGE_pixord
  bool "pixord"

endchoice
endif

if PACKAGE_networkmanager
	source ipcam/networkmanager/Kconfig
endif

endmenu
```

## rts3901_sdk_v1.2.1_turn-key/users/ipcam/dbgutils/Kconfig
```kconfig
config PACKAGE_dbgutils_iomem
	tristate "iomem"
	default n
	help
	  iomem

config dbgutils_test_iodma
	tristate "iodma"
	depends on PACKAGE_dbgutils_iomem
	default n
	help
	  iodma, dma test tool

config PACKAGE_dbgutils_efuse_mfg
	bool "efuse mfg"
	default n
	help
	  efuse manufacturer tools

config PACKAGE_dbgutils_eth_looptest
	bool "ethernet loopback test"
	default n
	help
	  Ethernet loopback test utility works when ethernet
	  TX and RX are short-circuited. Packet lose/bit error
	  with long distance transmission can be found.

config PACKAGE_dbgutils_uphymdio
	tristate "usb phy mdio"
	default n
	help
	  usb phy mdio

config PACKAGE_dbgutils_veridisk
	tristate "verify disk"
	default n
	help
	  verify disk

config PACKAGE_dbgutils_dbgisp
	tristate "debug isp"
	default n
	select PACKAGE_h1_encoder
	help
	  debug isp

config PACKAGE_dbgutils_sgctrl
	tristate "scsi commands"
	default n
	help
	  scsi commands

config PACKAGE_dbgutils_ptz
	tristate "PTZ"
	default n
	help
	  PTZ

config PACKAGE_dbgutils_wavetool
	tristate "wavetool"
	default n
	help
	  Ethernet IOL test tool

config PACKAGE_dbgutils_fephy
	tristate "fephy"
	default n
	help
	  Ethernet PHY read&write tool

config PACKAGE_dbgutils_monitor
	tristate "bus monitor"
	default n
	help
	  performance monitor initial tool
```

## rts3901_sdk_v1.2.1_turn-key/users/ipcam/isp_tuning/Kconfig
```kconfig
config RTSPD_INC
	bool "include mini RTSP Server"
	default n
	help
		Include mini RTSP Server will kill peacock & rtspd at startup.
```

## rts3901_sdk_v1.2.1_turn-key/users/ipcam/linux_test/Kconfig
```kconfig
config PACKAGE_linuxtest_testi2c
	tristate "testi2c"
	default n
	help
	  i2c designware master eeprom burning program

config PACKAGE_linuxtest_testSD
	tristate "testSD"
	default n
	select PACKAGE_fio
	select PACKAGE_dbgutils_veridisk
	help
	  SDCard hotplug,exception,stress test.

config PACKAGE_linuxtest_testusb
        tristate "testusb"
        default n
        help
           usb host and device transfer test

if PACKAGE_linuxtest_testusb

config PACKAGE_linuxtest_testusb_device
	tristate "testusb_device"
	default n
	help
	  to test usb device of ipcam

config PACKAGE_linuxtest_testusb_host
	tristate "testusb_host"
	default n
	help
	  to test usb host of ipcam

endif #PACKAGE_linuxtest_testusb

config PACKAGE_linuxtest_testuvc
        tristate "testuvc"
        default n
        help
           uvc gadget driver test

config PACKAGE_linuxtest_testnm
        tristate "testnm"
        default n
        select PACKAGE_cunit
        help
           realsil ipcam network manager library cunit test

config PACKAGE_linuxtest_hidgadget
        tristate "hidgadget"
        default n
        help
           hid gadget driver test

config PACKAGE_linuxtest_testwd
        tristate "testwd"
        default n
        help
           uvc gadget driver test

config PACKAGE_linuxtest_testvideo
        tristate "testvideo"
        default n
        help
          video(isp/h264) test

config PACKAGE_linuxtest_testrtc
        tristate "testrtc"
        default n
        help
          rtc test

config PACKAGE_linuxtest_testcipher
	tristate "testcipher"
	default n
	help
	  cipher test

config PACKAGE_linuxtest_testaudio
	tristate "testaudio"
	default n
	help
	  audio test

config PACKAGE_linuxtest_testisp
        tristate "testisp"
        default n
        help
          isp cmd test
```

## rts3901_sdk_v1.2.1_turn-key/users/ipcam/networkmanager/Kconfig
```kconfig
#
# Realtek Semiconductor Corp.
#
# Hurray_niu (hurray_niu@realsil.com.cn)
# July. 7, 2015
#

config PACKAGE_nm_init
	tristate "nm_init"
	default n

config PACKAGE_nm_cfg
	tristate "nm_cfg"
	default n

if PACKAGE_nm_cfg
config Enable_set_ethaddr
	bool "Enable setting ethernet mac address"
	default n
endif

config PACKAGE_nm_wps
	tristate "nm_wps"
	default n
	help
	  if select PACHAGE_wlan_wps, you should enable GPIO_SYSFS & WLAN_WPS
	  in kernel setting

if PACKAGE_nm_wps
	config WPS_LED_NUM
		int "wps_led_num(1-16)"
		range 1 16
		default "9"
endif
```

## rts3901_sdk_v1.2.1_turn-key/users/ipcam/octopus_plugin/Kconfig
```kconfig
config OCTOPUS_PLUGIN_CAM
	bool "plugin camera"
	select PACKAGE_peacock
	select PACKAGE_libmtd
	default n

config OCTOPUS_PLUGIN_CAM_UNIT_TEST
	bool "plugin camera unit test"
	depends on OCTOPUS_PLUGIN_CAM
	select PACKAGE_cunit
	select PACKAGE_jsonc
	select PACKAGE_peacock
	default n

config OCTOPUS_PLUGIN_NM
	bool "plugin network manager"
	default n

if (OCTOPUS_PLUGIN_NM)
config FEATURE_IPV6
	bool "Enable IPv6 support"
	default n
	help
	  add ipv6 interface support for webpages
	  nm_cfg & nm_init.
endif

config OCTOPUS_PLUGIN_UVC
	bool  "plugin UVC"
	select PACKAGE_peacock
	default n
```

## rts3901_sdk_v1.2.1_turn-key/users/libs/Kconfig
```kconfig
#
# Realtek Semiconductor Corp.
#
# Tony Wu (tonywu@realtek.com)
# Dec. 7, 2008
#

menu "Libraries"

config PACKAGE_binutils
	tristate "binutils"
	default n
	help
	  Include binutils-2.19, bfd, libiberty and opcodes. objdump will be
	  installed.

config PACKAGE_elfutils
	tristate "elfutils"
	default n
	select PACKAGE_gettext
	select PACKAGE_zlib
	help
	  elfutils

config PACKAGE_libaio
	tristate "libaio"
	default n
	help
	  libaio

config PACKAGE_libdwarf
	tristate "libdwarf"
	default n
	select PACKAGE_elfutils
	help
	  libdwarf

config PACKAGE_gettext
	tristate "gettext"
	default n
	select PACKAGE_libiconv
	help
	  gettext

config PACKAGE_libiconv
	tristate "libiconv"
	default n
	help
	  iconv library

config PACKAGE_openssl
	bool "openssl"
	default n
	select PACKAGE_zlib
	help
	  This is the openssl library.

config PACKAGE_libpng
	bool "libpng"
	default n
	select PACKAGE_zlib
	help
	  This is the png library, only for demonstration.

config PACKAGE_libusb
	tristate "libusb"
	default n
	help
	  This is the libusb library.

config PACKAGE_zlib
	bool "zlib"
	default n
	help
	  This is the zlib compression library.

config PACKAGE_lzo
	bool "lzo"
	default n
	help
	  LZO is a portable lossless data compression library written in ANSI C.

config PACKAGE_libuuid
	bool "libuuid"
	default n
	help
	  The libuuid library is used to generate unique identifiers for objects
	  that may be accessible beyond the local system.

config PACKAGE_libpopt
	tristate "libpopt"
	default n
	help
	  libpopt

config PACKAGE_jsonc
	tristate "json-c"
	default n
	help
	  json-c

config PACKAGE_alsalib
	tristate "alsa-lib"
	default n
	help
	  alsa-lib

config PACKAGE_pcre
	tristate "pcre"
	default n
	help
	  The Perl Compatible Regular Expressions (PCRE) library

config PACKAGE_cunit
	tristate "cunit"
	default n
	help
	  A Unit Testing Framework for C

config PACKAGE_opencore_amr
	tristate "opencore-amr"
	default n
	help
	  library opencore-amr

config PACKAGE_libmtd
	tristate "libmtd"
	default n

endmenu
```

## rts3901_sdk_v1.2.1_turn-key/users/network/Kconfig
```kconfig
#
# Realtek Semiconductor Corp.
#
# Tony Wu (tonywu@realtek.com)
# Dec. 7, 2008
#

menu "Network Applications"

config PACKAGE_lighttpd
	tristate "lighttpd"
	default n
	select PACKAGE_pcre
	select PACKAGE_libauth
	help
	  Lighttpd web server

config PACKAGE_iptables
	tristate "iptables"
	default n

config PACKAGE_curl
	tristate "curl"
	default n

config PACKAGE_tcpdump
	bool "tcpdump"
	default n
	select PACKAGE_libpcap
	help
	  dump traffic on a network

config PACKAGE_libpcap
	bool "libpcap"
	default n
	help
	  Packet Capture library

config PACKAGE_iproute2
	tristate "iproute2"
	default n

config PACKAGE_samba
	tristate "samba"
	default n

config PACKAGE_ppp
	bool "ppp"
	default n
	help
	  ppp (Paul's PPP Package) is an open source
	  package which implements the Point-to-Point
	  Protocol (PPP) on Linux and Solaris systems.

config PACKAGE_ethtool
	tristate "ethtool"
	default n

config PACKAGE_ifstat
	bool "ifstat"
	default n
	help
	  Ifstat is a little tool to report interface
	  activity, just like iostat/vmstat do for
	  other system statistics.

config PACKAGE_wpa_supplicant_hostapd
	tristate "wpa_supplicant_hostapd"
	default n

if PACKAGE_wpa_supplicant_hostapd

config PACKAGE_hostapd
	tristate "hostapd"
	select PACKAGE_openssl
	default n
config PACKAGE_supplicant
	tristate "wpa_supplicant"
	select PACKAGE_openssl
	default n

endif

config PACKAGE_dnrd
	tristate "dnrd"
	default n

config PACKAGE_miniupnpd
	tristate "miniupnpd"
	select PACKAGE_librtsnm
	default y

config PACKAGE_mDNSResponder
	tristate "mDNSResponder"
	select PACKAGE_librtsnm
	default y

config PACKAGE_autoipd
	tristate "autoipd"
	default y

config PACKAGE_rtwpriv
	tristate "rtwpriv"
	default n
config PACKAGE_wireless_tool
	tristate "wireless_tool"
	default n
endmenu
```

## rts3901_sdk_v1.2.1_turn-key/users/rtscore/3rdparty/Kconfig
```kconfig
config PACKAGE_3rdparty_libaacenc
	tristate "libaacenc"
	default n

config PACKAGE_3rdparty_tutk
	tristate "TUTK"
	default n

config PACKAGE_3rdparty_librtsaec
	tristate "librtsaec"
	default n

config PACKAGE_3rdparty_librtsmp3
	tristate "librtsmp3"
	default n
```
