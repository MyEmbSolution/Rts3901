## rts3901_sdk_v1.2.1_turn-key/users/system/Kconfig
```kconfig
#
# Realtek Semiconductor Corp.
#
# Tony Wu (tonywu@realtek.com)
# Dec. 7, 2008
#

menu "Base System"

config PACKAGE_busybox
	bool "busybox"
	default y
	help
	  BusyBox combines tiny versions of many common UNIX utilities into
	  a single small executable.  It provides minimalist replacements
	  for most of the utilities you usually find in fileutils, shellutils,
	  findutils, textutils, grep, gzip, tar, etc.  Simply select those
	  utilities and options you want.

config PACKAGE_example
	tristate "example"
	select PACKAGE_cunit
	select PACKAGE_libmtd
	default n
	help
	  A small example, only for demonstration.

endmenu
```

## rts3901_sdk_v1.2.1_turn-key/users/utils/Kconfig
```kconfig
#
# Realtek Semiconductor Corp.
#
# Tony Wu (tonywu@realtek.com)
# Dec. 7, 2008
#

menu "Utils"

config PACKAGE_adb
	tristate "adb"
	default n

config PACKAGE_iwlib
        tristate "iwlib"
        default n
	help
	  Wireless tools

config PACKAGE_lrzsz
	tristate "lrzsz"
	default n
	help
	  a unix communication package lrzsz

config PACKAGE_prelink
	tristate "prelink"
	default n
	select PACKAGE_elfutils
	help
	  Prelink tool

config PACKAGE_usbutils
        tristate "usbutils"
        default n
	select PACKAGE_libusb
	select PACKAGE_libiconv
	help
	  usbutils

config PACKAGE_mtdutils
        tristate "mtd-utils"
        default n
	select PACKAGE_zlib
	select PACKAGE_lzo
	select PACKAGE_libuuid
	help
	  usbutils

config PACKAGE_alsautils
	tristate "alsa utils"
	select PACKAGE_alsalib
	default n
	help
	  alsa utils

config PACKAGE_ntpclient
	tristate "ntpclient"
	select PACKAGE_libsysconf
	select PACKAGE_jsonc
	default n
	help
	  ntpclient

endmenu
```
